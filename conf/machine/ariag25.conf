## conf/machine/ariag25.conf
```bitbake
#@TYPE: Machine
#@NAME: AT91SAM9G25EK
#@DESCRIPTION: Machine configuration for the Atmel AT91SAM9G25EK
TARGET_ARCH = "arm"

require conf/machine/include/at91.inc
# require conf/machine/include/at91-lcd.inc
require conf/machine/include/atmel-bsp-2011.03.inc

MACHINE_FEATURES += "usbhost"
MACHINE_FEATURES += "ethernet"

# Ship all kernel modules by default
MACHINE_EXTRA_RRECOMMENDS = " kernel-modules"

UBOOT_MACHINES = "at91sam9x5ek_nandflash at91sam9x5ek_dataflash at91sam9x5ek"

AT91BOOTSTRAP_MACHINES = "at91sam9x5df at91sam9x5nf at91sam9x5sd_uboot at91sam9x5ek at91sam9x5sd"

PREFERRED_VERSION_u-boot_ariag25="u-boot-2010.06"

PREFERRED_PROVIDER_virtual/kernel = "linux-yocto-custom"
PREFERRED_VERSION_linux-yocto-custom = "2.6.39"
```

## conf/machine/at91cap9adk.conf
```bitbake
#@TYPE: Machine
#@NAME: AT91CAP9ADK
#@DESCRIPTION: Machine configuration for the Atmel AT91CAP9ADK
TARGET_ARCH = "arm"

require conf/machine/include/at91.inc
require conf/machine/include/at91-lcd.inc
require conf/machine/include/atmel-bsp-2010.03.inc

MACHINE_FEATURES += "usbhost"
MACHINE_FEATURES += "ethernet"

UBOOT_MACHINES = "at91cap9adk"

AT91BOOTSTRAP_MACHINES = "at91cap9adk at91cap9df at91cap9f"
```

## conf/machine/at91sam9260ek.conf
```bitbake
#@TYPE: Machine
#@NAME: AT91SAM9260EK
#@DESCRIPTION: Machine configuration for the Atmel AT91SAM9260EK
TARGET_ARCH = "arm"

require conf/machine/include/at91.inc
# require conf/machine/include/at91-lcd.inc
require conf/machine/include/atmel-bsp-2010.03.inc

MACHINE_FEATURES += "usbhost"
MACHINE_FEATURES += "ethernet"

UBOOT_MACHINES = "at91sam9260ek at91sam9260ek_dataflash_cs0 at91sam9260ek_dataflash_cs1 at91sam9260ek_nandflash"

AT91BOOTSTRAP_MACHINES = "at91sam9260df at91sam9260nf at91sam9260ek at91sam9260dfc"
```

## conf/machine/at91sam9261ek.conf
```bitbake
#@TYPE: Machine
#@NAME: AT91SAM9261EK
#@DESCRIPTION: Machine configuration for the Atmel AT91SAM9261EK
TARGET_ARCH = "arm"

require conf/machine/include/at91.inc
require conf/machine/include/at91-lcd.inc
require conf/machine/include/atmel-bsp-2010.03.inc

MACHINE_FEATURES += "usbhost"
# MACHINE_FEATURES += "ethernet"

UBOOT_MACHINES = "at91sam9261ek at91sam9261ek_dataflash_cs0 at91sam9261ek_dataflash_cs3 at91sam9261ek_nandflash"

AT91BOOTSTRAP_MACHINES = "at91sam9261ek at91sam9261nf at91sam9261dfc at91sam9261df"
```

## conf/machine/at91sam9263ek.conf
```bitbake
#@TYPE: Machine
#@NAME: AT91SAM9263EK
#@DESCRIPTION: Machine configuration for the Atmel AT91SAM9263EK
TARGET_ARCH = "arm"

require conf/machine/include/at91.inc
require conf/machine/include/at91-lcd.inc
require conf/machine/include/atmel-bsp-2010.03.inc

MACHINE_FEATURES += "usbhost"
MACHINE_FEATURES += "ethernet"

UBOOT_MACHINES = "at91sam9263ek at91sam9263ek_dataflash at91sam9263ek_dataflash_cs0 at91sam9263ek_nandflash at91sam9263ek_norflash at91sam9263ek_norflash_boot"

AT91BOOTSTRAP_MACHINES = "at91sam9263nf at91sam9263df at91sam9263dfc at91sam9263ek"
```

## conf/machine/at91sam9g10ek.conf
```bitbake
#@TYPE: Machine
#@NAME: AT91SAM9G10EK
#@DESCRIPTION: Machine configuration for the Atmel AT91SAM9G10EK
TARGET_ARCH = "arm"

require conf/machine/include/at91.inc
require conf/machine/include/at91-lcd.inc
require conf/machine/include/atmel-bsp-2010.03.inc

MACHINE_FEATURES += "usbhost"
# MACHINE_FEATURES += "ethernet"

UBOOT_MACHINES = "at91sam9g10ek at91sam9g10ek_dataflash_cs0 at91sam9g10ek_dataflash_cs3 at91sam9g10ek_nandflash"

AT91BOOTSTRAP_MACHINES = "at91sam9g10ek at91sam9g10df at91sam9g10nf at91sam9g10sd"
```

## conf/machine/at91sam9g15ek.conf
```bitbake
#@TYPE: Machine
#@NAME: AT91SAM9G15EK
#@DESCRIPTION: Machine configuration for the Atmel AT91SAM9G15EK
TARGET_ARCH = "arm"

require conf/machine/include/at91.inc
require conf/machine/include/at91-lcd.inc
require conf/machine/include/atmel-bsp-2011.03.inc

MACHINE_FEATURES += "usbhost"
# MACHINE_FEATURES += "ethernet"

UBOOT_MACHINES = "at91sam9x5ek_nandflash at91sam9x5ek_dataflash at91sam9x5ek"

AT91BOOTSTRAP_MACHINES = "at91sam9x5df at91sam9x5nf at91sam9x5sd_uboot at91sam9x5ek at91sam9x5sd"
```

## conf/machine/at91sam9g20ek.conf
```bitbake
#@TYPE: Machine
#@NAME: AT91SAM9G20EK
#@DESCRIPTION: Machine configuration for the Atmel AT91SAM9G20EK
TARGET_ARCH = "arm"

require conf/machine/include/at91.inc
# require conf/machine/include/at91-lcd.inc
require conf/machine/include/atmel-bsp-2010.03.inc

MACHINE_FEATURES += "usbhost"
MACHINE_FEATURES += "ethernet"

UBOOT_MACHINES = "at91sam9g20ek at91sam9g20ek_dataflash_cs0 at91sam9g20ek_dataflash_cs1 at91sam9g20ek_nandflash at91sam9g20ek_sd"

AT91BOOTSTRAP_MACHINES = "at91sam9g20ek at91sam9g20df at91sam9g20sd at91sam9g20nf at91sam9g20dfc"
```

## conf/machine/at91sam9g20ek_2mmc.conf
```bitbake
#@TYPE: Machine
#@NAME: AT91SAM9G20EK
#@DESCRIPTION: Machine configuration for the Atmel AT91SAM9G20EK
TARGET_ARCH = "arm"

require conf/machine/include/at91.inc
# require conf/machine/include/at91-lcd.inc
require conf/machine/include/atmel-bsp-2010.03.inc

MACHINE_FEATURES += "usbhost"
MACHINE_FEATURES += "ethernet"

UBOOT_MACHINES = "at91sam9g20ek_2mmc at91sam9g20ek_2mmc_dataflash_cs0 at91sam9g20ek_2mmc_dataflash_cs1 at91sam9g20ek_2mmc_nandflash at91sam9g20ek_2mmc_sd"

AT91BOOTSTRAP_MACHINES = "at91sam9g20ek_2mmcdf at91sam9g20ek_2mmc at91sam9g20ek_2mmcsd at91sam9g20ek_2mmcnf at91sam9g20ek_2mmcdfc"
```

## conf/machine/at91sam9g35ek.conf
```bitbake
#@TYPE: Machine
#@NAME: AT91SAM9G35EK
#@DESCRIPTION: Machine configuration for the Atmel AT91SAM9G35EK
TARGET_ARCH = "arm"

require conf/machine/include/at91.inc

PREFERRED_PROVIDER_virtual/xserver = "xserver-xorg"
XSERVER = "xserver-xorg \
           xf86-input-evdev \
           xf86-input-mouse \
           xf86-input-tslib \
           xf86-video-fbdev \
           xf86-input-keyboard \
	"

GUI_MACHINE_CLASS = "smallscreen"

MACHINE_FEATURES += "screen"
MACHINE_FEATURES += "touchscreen"
MACHINE_FEATURES += "usbhost"
MACHINE_FEATURES += "ethernet"

UBOOT_MACHINES = "at91sam9x5ek_nandflash at91sam9x5ek_dataflash at91sam9x5ek"
UBOOT_MACHINE = "at91sam9x5ek"

PREFERRED_VERSION_u-boot = "2010.06"

AT91BOOTSTRAP_MACHINES = "at91sam9x5df at91sam9x5nf at91sam9x5sd_uboot at91sam9x5ek at91sam9x5sd"
```

## conf/machine/at91sam9g45ek.conf
```bitbake
#@TYPE: Machine
#@NAME: AT91SAM9G45EK
#@DESCRIPTION: Machine configuration for the Atmel AT91SAM9G45EK - A virtual board for SAM9G45/G46 production boards.
TARGET_ARCH = "arm"

require conf/machine/include/at91.inc
require conf/machine/include/at91-lcd.inc
require conf/machine/include/atmel-bsp-2010.03.inc

MACHINE_FEATURES += "usbhost"
MACHINE_FEATURES += "ethernet"

UBOOT_MACHINES = "at91sam9m10g45ek at91sam9m10g45ek_dataflash at91sam9m10g45ek_dataflash_cs0 at91sam9m10g45ek_nandflash at91sam9m10g45ek_sd"

AT91BOOTSTRAP_MACHINES = "at91sam9g45nf at91sam9g45df at91sam9g45ek at91sam9g45sd"
```

## conf/machine/at91sam9g45ekes.conf
```bitbake
#@TYPE: Machine
#@NAME: AT91SAM9G45EKES
#@DESCRIPTION: Machine configuration for the Atmel AT91SAM9G45EKES
TARGET_ARCH = "arm"

require conf/machine/include/at91.inc
require conf/machine/include/at91-lcd.inc
require conf/machine/include/atmel-bsp-2010.03.inc

MACHINE_FEATURES += "usbhost"
MACHINE_FEATURES += "ethernet"

UBOOT_MACHINES = "at91sam9g45ekes at91sam9g45ekes_dataflash at91sam9g45ekes_dataflash_cs0 at91sam9g45ekes_nandflash at91sam9m10ekes_sd"

AT91BOOTSTRAP_MACHINES = "at91sam9g45sdes_android at91sam9g45nfes at91sam9g45sdes at91sam9g45ekes at91sam9g45dfes"
```

## conf/machine/at91sam9m10ekes.conf
```bitbake
#@TYPE: Machine
#@NAME: AT91SAM9M10EKES
#@DESCRIPTION: Machine configuration for the Atmel AT91SAM9M10EKES
TARGET_ARCH = "arm"

require conf/machine/include/at91.inc
require conf/machine/include/at91-lcd.inc
require conf/machine/include/atmel-bsp-2010.03.inc

MACHINE_FEATURES += "usbhost"
MACHINE_FEATURES += "ethernet"

UBOOT_MACHINES = "at91sam9m10ekes at91sam9m10ekes_dataflash_cs0 at91sam9m10ekes_dataflash_cs1 at91sam9m10ekes_nandflash at91sam9m10ekes_sd"

AT91BOOTSTRAP_MACHINES = "at91sam9m10nfes at91sam9m10ekes at91sam9m10sdes at91sam9m10dfes"
```

## conf/machine/at91sam9m10g45ek.conf
```bitbake
#@TYPE: Machine
#@NAME: AT91SAM9M10G45EK
#@DESCRIPTION: Machine configuration for the Atmel AT91SAM9M10G45EK
TARGET_ARCH = "arm"

require conf/machine/include/at91.inc
require conf/machine/include/at91-lcd.inc
require conf/machine/include/atmel-bsp-2010.03.inc

MACHINE_FEATURES += "usbhost"
MACHINE_FEATURES += "ethernet"

UBOOT_MACHINES = "at91sam9m10g45ek at91sam9m10g45ek_dataflash at91sam9m10g45ek_dataflash_cs0 at91sam9m10g45ek_nandflash at91sam9m10g45ek_sd"

AT91BOOTSTRAP_MACHINES = "at91sam9m10nf at91sam9m10ek at91sam9m10df at91sam9m10sdu at91sam9m10sd at91sam9m10sd_android"
```

## conf/machine/at91sam9rlek.conf
```bitbake
#@TYPE: Machine
#@NAME: AT91SAM9RLEK
#@DESCRIPTION: Machine configuration for the Atmel AT91SAM9RLEK
TARGET_ARCH = "arm"

require conf/machine/include/at91.inc
require conf/machine/include/at91-lcd.inc
require conf/machine/include/atmel-bsp-2010.03.inc

# MACHINE_FEATURES += "usbhost"
# MACHINE_FEATURES += "ethernet"

UBOOT_MACHINES = "at91sam9rlek at91sam9rlek_dataflash at91sam9rlek_dataflash_cs0 at91sam9rlek_nandflash at91sam9rlek_sd"

AT91BOOTSTRAP_MACHINES = "at91sam9rlsd at91sam9rlnf at91sam9rlek at91sam9rldf"
```

## conf/machine/at91sam9x35ek.conf
```bitbake
#@TYPE: Machine
#@NAME: AT91SAM9X35EK
#@DESCRIPTION: Machine configuration for the Atmel AT91SAM9X35EK
TARGET_ARCH = "arm"

require conf/machine/include/at91.inc
require conf/machine/include/at91-lcd.inc
require conf/machine/include/atmel-bsp-2011.03.inc

MACHINE_FEATURES += "usbhost"
MACHINE_FEATURES += "ethernet"

UBOOT_MACHINES = "at91sam9x5ek_nandflash at91sam9x5ek_dataflash at91sam9x5ek"

AT91BOOTSTRAP_MACHINES = "at91sam9x5df at91sam9x5nf at91sam9x5sd_uboot at91sam9x5ek at91sam9x5sd"

KERNEL_CONFIG	= "file://at91sam9gx5ek_defconfig"

LOGO_SIZE = "wvga"
```

## conf/machine/at91sam9xeek.conf
```bitbake
#@TYPE: Machine
#@NAME: AT91SAM9XEEEK
#@DESCRIPTION: Machine configuration for the Atmel AT91SAM9XEEK
TARGET_ARCH = "arm"

require conf/machine/include/at91.inc
# require conf/machine/include/at91-lcd.inc
require conf/machine/include/atmel-bsp-2010.03.inc

MACHINE_FEATURES += "usbhost"
MACHINE_FEATURES += "ethernet"

UBOOT_MACHINES = "at91sam9xeek at91sam9xeek_dataflash_cs0 at91sam9xeek_dataflash_cs1 at91sam9xeek_nandflash"

AT91BOOTSTRAP_MACHINES = "at91sam9xeek at91sam9xedfc at91sam9xedf at91sam9xenf"
```

## conf/machine/include/at91-lcd.inc
```bitbake
# X-Server ********************************************************************

PREFERRED_PROVIDER_virtual/xserver = "xserver-xorg"
XSERVER = "xserver-xorg \
           xf86-input-evdev \
           xf86-input-mouse \
           xf86-input-tslib \
           xf86-video-fbdev \
           xf86-input-keyboard \
	"

GUI_MACHINE_CLASS = "smallscreen"

MACHINE_FEATURES += "screen"
MACHINE_FEATURES += "touchscreen"
```

## conf/machine/include/at91.inc
```bitbake
SOC_FAMILY = "at91"

require conf/machine/include/tune-arm926ejs.inc

MACHINE_FEATURES = "kernel26 serial usbgadget vfat mmc alsa ext2"

# *** Root File System ********************************************************
# IMAGE_FSTYPES ?= "jffs2 tar.bz2 ubi"
IMAGE_FSTYPES ?= "jffs2 tar.bz2"

EXTRA_IMAGECMD_jffs2 = "--pad --little-endian --eraseblock=0x20000 -n"

# Ship all kernel modules
MACHINE_EXTRA_RRECOMMENDS = " kernel-modules"

# If we use UBI File System
# do ubiattach /dev/ubi_ctrl -m 4
# From dmesg:
# UBI: smallest flash I/O unit:    2048
# UBI: logical eraseblock size:    129024 bytes
# from ubiattach stdout:
# UBI device number 0, total 1996 LEBs
MKUBIFS_ARGS = "-m 2048 -e 129024 -c 1996"

# do ubiattach /dev/ubi_ctrl -m 4
# from dmesg:
# UBI: smallest flash I/O unit:    2048
# UBI: physical eraseblock size:   131072 bytes (128 KiB)
# UBI: sub-page size:              512
UBINIZE_ARGS = "-m 2048 -p 128KiB -s 512"


# *** KERNEL ******************************************************************
# Increase this everytime you change something in the kernel
KERNEL_IMAGETYPE = "uImage"


# Boot parameters *************************************************************
SERIAL_CONSOLE ?= "115200 ttyS0"
USE_VT = "0"


# **** U-Boot *****************************************************************
EXTRA_IMAGEDEPENDS += "u-boot"
UBOOT_ARCH = "arm"
# UBOOT_ENTRYPOINT = "0x80008000"
# UBOOT_LOADADDRESS = "0x80008000"


# *** at91bootstrap ***********************************************************
EXTRA_IMAGEDEPENDS += "at91bootstrap"
```

## conf/machine/include/atmel-bsp-2010.03.inc
```bitbake
ATMEL_MIRROR ?= "ftp://ftp.at91.com/pub/"

PREFERRED_PROVIDER_virtual/kernel = "linux"
PREFERRED_VERSION_virtual/kernel = "2.6.30"
MACHINE_KERNEL_PR = "r0"

PREFERRED_PROVIDER_virtual/bootloader = "u-boot"
PREFERRED_VERSION_u-boot = "2009.11"

PREFERRED_VERSION_at91bootstrap = "3.1.2"
```

## conf/machine/include/atmel-bsp-2011.03.inc
```bitbake
ATMEL_MIRROR ?= "ftp://ftp.at91.com/pub/"

PREFERRED_PROVIDER_virtual/kernel = "linux-atmel-git"
PREFERRED_VERSION_virtual/kernel = "2.6.39"
MACHINE_KERNEL_PR = "r0"

PREFERRED_PROVIDER_virtual/bootloader = "u-boot"
PREFERRED_VERSION_u-boot = "2010.06"

PREFERRED_VERSION_at91bootstrap = "3.1.2"
```

## conf/machine/include/atmel-bsp-2013.inc
```bitbake
ATMEL_MIRROR ?= "ftp://ftp.at91.com/pub/"

PREFERRED_PROVIDER_virtual/kernel = "linux"
PREFERRED_VERSION_virtual/kernel = "3.6.9"
MACHINE_KERNEL_PR = "r0"

PREFERRED_PROVIDER_virtual/bootloader = "u-boot"
PREFERRED_VERSION_u-boot = "2010.06"

PREFERRED_VERSION_at91bootstrap = "3.1.2"
```

## conf/machine/to-be-fixed/template.conf
```bitbake
#@TYPE: Machine
#@NAME: AT91SAM9G35EK
#@DESCRIPTION: Machine configuration for the Atmel AT91SAM9G35EK
TARGET_ARCH = "arm"

PREFERRED_PROVIDER_virtual/xserver = "xserver-xorg"
XSERVER = "xserver-xorg \
           xf86-input-evdev \
           xf86-input-mouse \
           xf86-input-tslib \
           xf86-video-fbdev \
           xf86-input-keyboard \
	"

GUI_MACHINE_CLASS = "smallscreen"

require conf/machine/include/at91.inc

# Ship all kernel modules

IMAGE_FSTYPES ?= "jffs2 tar.bz2 ubi"
EXTRA_IMAGECMD_jffs2 = "-lnp -e 0x20000 -s 2048"

SERIAL_CONSOLE = "115200 ttyS0"
USE_VT = "0"

PREFERRED_PROVIDER_virtual/kernel = "linux"

PREFERRED_PROVIDER_virtual/bootloader = "u-boot"

UBOOT_ARCH = "arm"
UBOOT_MACHINES = "at91sam9g35ek_config"
AT91BOOTSTRAP_MACHINES = "at91sam9g35ek at91sam9g35df at91sam9g35nf at91sam9g35sd"

MACHINE_EXTRA_RRECOMMENDS = " kernel-modules"

MACHINE_FEATURES += "screen"
MACHINE_FEATURES += "touchscreen"
MACHINE_FEATURES += "usbhost"
MACHINE_FEATURES += "ethernet"

# NOTE: there are NAND and OneNAND versions of this board...

# do ubiattach /dev/ubi_ctrl -m 4
# From dmesg:
# UBI: smallest flash I/O unit:    2048
# UBI: logical eraseblock size:    129024 bytes
# from ubiattach stdout:
# UBI device number 0, total 1996 LEBs
MKUBIFS_ARGS = "-m 2048 -e 129024 -c 1996"

# do ubiattach /dev/ubi_ctrl -m 4
# from dmesg:
# UBI: smallest flash I/O unit:    2048
# UBI: physical eraseblock size:   131072 bytes (128 KiB)
# UBI: sub-page size:              512
UBINIZE_ARGS = "-m 2048 -p 128KiB -s 512"
```
